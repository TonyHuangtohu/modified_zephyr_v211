## prj.conf
```kconfig
# nothing here
#Tony ever built it.
```

## src/main.c
```c
/*
 * Copyright (c) 2012-2014 Wind River Systems, Inc.
 *
 * SPDX-License-Identifier: Apache-2.0
 */

#include <zephyr/zephyr.h>

void main(void)
{
	printk("Hello World! %s\n", CONFIG_BOARD);
	//Tony to modified for test
}
```
